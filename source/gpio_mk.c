/*
 ===========================================================================================================================================================================
																																			SOURCE FILE
																																			GPIO DRIVER
																																			NUCLEO L476RG
																																			MICHAL KRUK

  ===========================================================================================================================================================================
*/ 

/* ---------------------> INCLUDES */
#include "gpio_mk.h"
/* ---------------------> MACROS */

/* ---------------------> VARIABLES */
GPIO_InitTypeDef gpio_struct;

/* ---------------------> FUNCTIONS */

/*
 ===========================================================================================================================================================================
																					
																							GPIO INIT FUNCTION

  ===========================================================================================================================================================================
*/ 
void gpio_init(GPIO_TypeDef  *GPIOx , uint32_t PINx , uint32_t Mode , uint32_t Pull ){
		
	
	if( GPIOx == GPIOA) __HAL_RCC_GPIOA_CLK_ENABLE();
	if( GPIOx == GPIOB) __HAL_RCC_GPIOB_CLK_ENABLE();
	if( GPIOx == GPIOC) __HAL_RCC_GPIOC_CLK_ENABLE();
	if( GPIOx == GPIOD) __HAL_RCC_GPIOD_CLK_ENABLE();
	if( GPIOx == GPIOE) __HAL_RCC_GPIOE_CLK_ENABLE();
	if( GPIOx == GPIOF) __HAL_RCC_GPIOF_CLK_ENABLE();
	if( GPIOx == GPIOG) __HAL_RCC_GPIOG_CLK_ENABLE();
	if( GPIOx == GPIOH) __HAL_RCC_GPIOH_CLK_ENABLE();
	
	gpio_struct.Mode = Mode;
	gpio_struct.Pin  = PINx;
	gpio_struct.Pull = Pull;
	
	HAL_GPIO_Init(GPIOx , &gpio_struct);

}

/*
 ===========================================================================================================================================================================
																					
																							GPIO SET

  ===========================================================================================================================================================================
*/ 

void gpio_set(GPIO_TypeDef  *GPIOx , uint32_t PINx ){
		HAL_GPIO_WritePin(GPIOx, PINx , GPIO_PIN_SET);
}

/*
 ===========================================================================================================================================================================
																					
																							GPIO RESET

  ===========================================================================================================================================================================
*/

void gpio_reset(GPIO_TypeDef  *GPIOx , uint32_t PINx ){
		HAL_GPIO_WritePin(GPIOx, PINx , GPIO_PIN_RESET);
}

/*
 ===========================================================================================================================================================================
																					
																							GPIO READ

  ===========================================================================================================================================================================
*/
uint8_t gpio_read(GPIO_TypeDef *GPIOx , uint32_t PINx){
		return HAL_GPIO_ReadPin(GPIOx , PINx);
}

/*
 ===========================================================================================================================================================================
																					
																							GPIO TOGGLE

  ===========================================================================================================================================================================
*/ 

void gpio_toggle(GPIO_TypeDef  *GPIOx , uint32_t PINx ){
		HAL_GPIO_TogglePin(GPIOx, PINx);
}

/*
// ===========================================================================================================================================================================

//																							KONIEC PLIKU

//  ===========================================================================================================================================================================
*/
