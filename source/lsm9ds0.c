/*
 ===========================================================================================================================================================================
																																			SOURCE FILE
																																			LSM9DS0 DRIVER
																																			NUCLEO L476RG
																																			MICHAL KRUK

  ===========================================================================================================================================================================
*/ 

#include "lsm9ds0.h"

// ----------------------------> Variables
volatile uint8_t config_stat;
volatile uint8_t read_stat;
/*
 ===========================================================================================================================================================================
																																			
																						KONFIGURACJA MODULU W TRYB PRACY : NORMAL MODE

  ===========================================================================================================================================================================
*/ 

void lsm_config(void){
	
	uint8_t data[1];
	uint8_t data1[1];
	uint8_t data2[1];
	data[0] = NORMAL_MODE;
	data1[0] = 0x17;
	data2[0] = 0x24;
		if((write_mem( WRITE_ADR_LSM , CTRL_REG1_G_ADR , MEMORY_SIZE_LSM , data , 1 )) != 0)	error_function();
	  if((write_mem( 0x3A , CTRL_REG1_G_ADR , MEMORY_SIZE_LSM , data1 , 1 )) != 0)	error_function();
		if((write_mem( 0x3A , CTRL_REG1_G_ADR , MEMORY_SIZE_LSM , data1 , 1 )) != 0)	error_function();
}

/*
 ===========================================================================================================================================================================
																																			
															GYROSCOPE OUT X

  ===========================================================================================================================================================================
*/ 

uint16_t gyro_x(void){

//bufor do odbioru z I2C
uint8_t 	gyro_x_buf[2];
//	
uint16_t 	gyro_x;
	
	read_stat = read_mem( READ_ADR_LSM , GYRO_X_ADR , MEMORY_SIZE_LSM , gyro_x_buf , 2);
	
	gyro_x = (gyro_x_buf[0] << 8);
	gyro_x = gyro_x_buf[1];
	
	return gyro_x;
}
/*
 ===========================================================================================================================================================================
																																			
															GYROSCOPE OUT Z

  ===========================================================================================================================================================================
*/ 

uint16_t gyro_z(void){

//bufor do odbioru z I2C
uint8_t 	gyro_z_buf[2];
//	
uint16_t 	gyro_z;
	
	read_mem( READ_ADR_LSM , GYRO_Z_ADR , MEMORY_SIZE_LSM , gyro_z_buf , 2 );
	
	gyro_z = (gyro_z_buf[0] << 8);
	gyro_z = gyro_z_buf[1];
	
	return gyro_z;
}
/*
 ===========================================================================================================================================================================
																																			
															GYROSCOPE OUT Y

  ===========================================================================================================================================================================
*/ 

uint16_t gyro_y(void){

//bufor do odbioru z I2C
uint8_t 	gyro_y_buf[2];
//	
uint16_t 	gyro_y;
	
	read_mem( READ_ADR_LSM , GYRO_Y_ADR , MEMORY_SIZE_LSM , gyro_y_buf , 2 );
	
	gyro_y = (gyro_y_buf[0] << 8);
	gyro_y = gyro_y_buf[1];
	
	return gyro_y;
}


/*
 ===========================================================================================================================================================================
																																			
															ACCELEROMETER OUT X

  ===========================================================================================================================================================================
*/ 
uint16_t accelerometer_x(void){

//bufor do odbioru z I2C
uint8_t 	acc_x_buf[2];
//	
uint16_t 	acc_x;
	
	read_mem( 0x3B , ACCELEROMETER_X_ADR , MEMORY_SIZE_LSM , acc_x_buf , 2 );
	
	acc_x = (acc_x_buf[0] << 8);
	acc_x = acc_x_buf[1];
	
	return acc_x;
}
/*
 ===========================================================================================================================================================================
																																			
															ACCELEROMETER OUT Z

  ===========================================================================================================================================================================
*/ 
uint16_t accelerometer_z(void){

//bufor do odbioru z I2C
uint8_t 	acc_z_buf[2];
//	
uint16_t 	acc_z;
	
	read_mem( 0x3B , ACCELEROMETER_Z_ADR , MEMORY_SIZE_LSM , acc_z_buf , 2 );
	
	acc_z = (acc_z_buf[0] << 8);
	acc_z = acc_z_buf[1];
	
	return acc_z;
}
/*
 ===========================================================================================================================================================================
																																			
															ACCELEROMETER OUT Y

  ===========================================================================================================================================================================
*/ 
uint16_t accelerometer_y(void){

//bufor do odbioru z I2C
uint8_t 	acc_y_buf[2];
//	
uint16_t 	acc_y;
	
	read_mem( 0x3B , ACCELEROMETER_Y_ADR , MEMORY_SIZE_LSM , acc_y_buf , 2 );
	
	acc_y = (acc_y_buf[0] << 8);
	acc_y = acc_y_buf[1];
	
	return acc_y;
}

/*
 ===========================================================================================================================================================================
																																			
															MAGNETOMETR X

  ===========================================================================================================================================================================
*/ 
uint16_t magnetometr_x(void){

//bufor do odbioru z I2C
uint8_t 	mag_x_buf[2];
//	
uint16_t 	mag_x;
	
	read_mem( 0x3B , MAGNETOMETER_X_ADR , MEMORY_SIZE_LSM , mag_x_buf , 2 );
	
	mag_x = (mag_x_buf[0] << 8);
	mag_x = mag_x_buf[1];
	
	return mag_x;
}
/*
 ===========================================================================================================================================================================
																																			
															MAGNETOMETR Z

  ===========================================================================================================================================================================
*/ 
uint16_t magnetometr_z(void){

//bufor do odbioru z I2C
uint8_t 	mag_z_buf[2];
//	
uint16_t 	mag_z;
	
	read_mem( 0x3B , MAGNETOMETER_Z_ADR , MEMORY_SIZE_LSM , mag_z_buf , 2 );
	
	mag_z = (mag_z_buf[0] << 8);
	mag_z = mag_z_buf[1];
	
	return mag_z;
}

/*
 ===========================================================================================================================================================================
																																			
															MAGNETOMETR Y

  ===========================================================================================================================================================================
*/ 
uint16_t magnetometr_y(void){

//bufor do odbioru z I2C
uint8_t 	mag_y_buf[2];
//	
uint16_t 	mag_y;
	
	read_mem( 0x3B , MAGNETOMETER_Y_ADR , MEMORY_SIZE_LSM , mag_y_buf , 2 );
	
	mag_y = (mag_y_buf[0] << 8);
	mag_y = mag_y_buf[1];
	
	return mag_y;
}
/*
 ===========================================================================================================================================================================
																																			END OF FILE
  ===========================================================================================================================================================================
*/ 


